## package/cdparanoia/Config.in
```kconfig
config BR2_PACKAGE_CDPARANOIA
        bool "cdparanoia"
        help
          Paranoia is a library that provides a unified, robust interface for Linux applications that want to use CDROM devices.

          https://www.xiph.org/paranoia
```

## package/gobject-introspection/Config.in
```kconfig
config BR2_PACKAGE_GOBJECT_INTROSPECTION
    bool "gobject-introspection"
    depends on BR2_TOOLCHAIN_GCC_AT_LEAST_4_3 # ldd
    select BR2_PACKAGE_HOST_QEMU
    select BR2_PACKAGE_PKGCONF
    select BR2_PACKAGE_LIBGLIB2
    select BR2_PACKAGE_PYTHON

    help
      gobject-introspection

      http://wiki.gnome.org/
```

## package/gstreamer1/gst1-python/Config.in
```kconfig
config BR2_PACKAGE_GST1_PYTHON
       bool "gst1-python"
       depends on BR2_PACKAGE_GSTREAMER1
       select BR2_PACKAGE_PYTHON_GOBJECT
       help
          GStreamer Python binding overrides (complementing the
          bindings provided by python-gi)

	  https://github.com/GStreamer/gst-python
```

## package/libdiscid/Config.in
```kconfig
config BR2_PACKAGE_LIBDISCID
        bool "libdiscid"
        help
          libdiscid is a C library for creating MusicBrainz and freedb disc IDs from audio CDs.

          https://musicbrainz.org/doc/libdiscid
	  
```

## package/libspotify-armhf/Config.in
```kconfig
config BR2_PACKAGE_LIBSPOTIFY_ARMHF
       bool "libspotify-armhf"
       help
	Download and install the binary libspotify-armhf library.
```

## package/python-backports_abc/Config.in
```kconfig
config BR2_PACKAGE_PYTHON_BACKPORTS_ABC
	bool "python-backports_abc"
	help
	  A backport of recent additions to the 'collections.abc' module.

	  https://github.com/cython/backports_abc
```

## package/python-backportsssl_match_hostname/Config.in
```kconfig
config BR2_PACKAGE_PYTHON_BACKPORTSSSL_MATCH_HOSTNAME
	bool "python-backportsssl_match_hostname"
	help
	  The ssl.match_hostname() function from Python 3.5

	  http://bitbucket.org/brandon/backports.ssl_match_hostname
```

## package/python-discid/Config.in
```kconfig
config BR2_PACKAGE_PYTHON_DISCID
	bool "python-discid"
	select BR2_PACKAGE_LIBDISCID
	help
	  Python binding of Libdiscid

	  https://python-discid.readthedocs.org/
```

## package/python-mopidy-cd/Config.in
```kconfig
config BR2_PACKAGE_PYTHON_MOPIDY_CD
	bool "python-mopidy-cd"
	select BR2_PACKAGE_PYTHON_SETUPTOOLS
	select BR2_PACKAGE_PYTHON_MOPIDY
	select BR2_PACKAGE_PYTHON_PYKKA
	select BR2_PACKAGE_PYTHON_DISCID
	help
	  Mopidy Extension to play audio CD

	  https://github.com/asartori/mopidy-cd
```

## package/python-mopidy-internetarchive/Config.in
```kconfig
config BR2_PACKAGE_PYTHON_MOPIDY_INTERNETARCHIVE
	bool "python-mopidy-internetarchive"
	select BR2_PACKAGE_PYTHON_SETUPTOOLS
	select BR2_PACKAGE_PYTHON_MOPIDY
	select BR2_PACKAGE_PYTHON_PYKKA
	select BR2_PACKAGE_PYTHON_REQUESTS
	select BR2_PACKAGE_PYTHON_CACHETOOLS
	select BR2_PACKAGE_PYTHON_URITOOLS
	help
	  Mopidy extension for playing music from the Internet Archive

	  https://github.com/tkem/mopidy-internetarchive
```

## package/python-mopidy-local-images/Config.in
```kconfig
config BR2_PACKAGE_PYTHON_MOPIDY_LOCAL_IMAGES
	bool "python-mopidy-local-images"
	select BR2_PACKAGE_PYTHON_SETUPTOOLS
	select BR2_PACKAGE_PYTHON_MOPIDY
	select BR2_PACKAGE_PYTHON_PYKKA
	select BR2_PACKAGE_PYTHON_URITOOLS
	help
	  Mopidy local library proxy extension for handling embedded album
	  art

	  https://github.com/mopidy/mopidy-local-images
```

## package/python-mopidy-material-webclient/Config.in
```kconfig
config BR2_PACKAGE_PYTHON_MOPIDY_MATERIAL_WEBCLIENT
	bool "python-mopidy-material-webclient"
	select BR2_PACKAGE_PYTHON_SETUPTOOLS # runtime
	select BR2_PACKAGE_PYTHON_MOPIDY # runtime
	select BR2_PACKAGE_PYTHON_WIFI # runtime
	help
	  A Mopidy web client with an Android Material feel.

	  https://github.com/matgallacher/mopidy-material-webclient
```

## package/python-mopidy-mobile/Config.in
```kconfig
config BR2_PACKAGE_PYTHON_MOPIDY_MOBILE
	bool "python-mopidy-mobile"
	select BR2_PACKAGE_PYTHON_SETUPTOOLS # runtime
	select BR2_PACKAGE_PYTHON_MOPIDY # runtime
	help
	  Mopidy Web client extension for mobile devices.

	  https://github.com/tkem/mopidy-mobile
```

## package/python-mopidy-moped/Config.in
```kconfig
config BR2_PACKAGE_PYTHON_MOPIDY_MOPED
	bool "python-mopidy-moped"
	select BR2_PACKAGE_PYTHON_SETUPTOOLS
	select BR2_PACKAGE_PYTHON_MOPIDY
	help
	  Responsive Web client for Mopidy

	  https://github.com/martijnboland/moped
```

## package/python-mopidy-mopify/Config.in
```kconfig
config BR2_PACKAGE_PYTHON_MOPIDY_MOPIFY
	bool "python-mopidy-mopify"
	select BR2_PACKAGE_PYTHON_SETUPTOOLS
	select BR2_PACKAGE_PYTHON_MOPIDY
	select BR2_PACKAGE_PYTHON_CONFIGOBJ
	help
	  A Mopidy Web client based on the (old) Spotify interface. Improved
	  to work with spotify as main library.

	  https://github.com/dirkgroenen/Mopify
```

## package/python-mopidy-musicbox-webclient/Config.in
```kconfig
config BR2_PACKAGE_PYTHON_MOPIDY_MUSICBOX_WEBCLIENT
	bool "python-mopidy-musicbox-webclient"
	select BR2_PACKAGE_PYTHON_SETUPTOOLS # runtime
	select BR2_PACKAGE_PYTHON_MOPIDY # runtime
	help
	  Mopidy MusicBox web extension.

	  https://github.com/woutervanwijk/mopidy-musicbox-webclient
```

## package/python-mopidy-party/Config.in
```kconfig
config BR2_PACKAGE_PYTHON_MOPIDY_PARTY
	bool "python-mopidy-party"
	select BR2_PACKAGE_PYTHON_SETUPTOOLS # runtime
	select BR2_PACKAGE_PYTHON_MOPIDY # runtime
	select BR2_PACKAGE_PYTHON_PYKKA # runtime
	help
	  Mopidy web extension designed for party.

	  https://github.com/Lesterpig/mopidy-party
```

## package/python-mopidy-spotify/Config.in
```kconfig
config BR2_PACKAGE_PYTHON_MOPIDY_SPOTIFY
	bool "python-mopidy-spotify"
	select BR2_PACKAGE_PYTHON_MOPIDY
	select BR2_PACKAGE_PYTHON_PYKKA
	select BR2_PACKAGE_PYTHON_PYSPOTIFY
	select BR2_PACKAGE_PYTHON_REQUESTS
	select BR2_PACKAGE_PYTHON_SETUPTOOLS
	help
	  Mopidy extension for playing music from Spotify

	  https://github.com/mopidy/mopidy-spotify
```

## package/python-mopidy-spotmop/Config.in
```kconfig
config BR2_PACKAGE_PYTHON_MOPIDY_SPOTMOP
	bool "python-mopidy-spotmop"
	select BR2_PACKAGE_PYTHON_SETUPTOOLS
	select BR2_PACKAGE_PYTHON_PYLAST
	select BR2_PACKAGE_PYTHON_SPOTIPY
	select BR2_PACKAGE_PYTHON_MOPIDY
	select BR2_PACKAGE_PYTHON_MOPIDY_LOCAL_IMAGES
	select BR2_PACKAGE_PYTHON_CONFIGOBJ
	help
	  A Mopidy Web client that utilizes the Spotify and EchoNest
	  frameworks

	  https://github.com/jaedb/spotmop
```

## package/python-mopidy-tunein/Config.in
```kconfig
config BR2_PACKAGE_PYTHON_MOPIDY_TUNEIN
	bool "python-mopidy-tunein"
	select BR2_PACKAGE_PYTHON_SETUPTOOLS
	select BR2_PACKAGE_PYTHON_MOPIDY
	select BR2_PACKAGE_PYTHON_PYKKA
	select BR2_PACKAGE_PYTHON_REQUESTS
	help
	  Mopidy extension for playing music from TuneIn.

	  https://github.com/kingosticks/mopidy-tunein
```

## package/python-mopidy-websettings/Config.in
```kconfig
config BR2_PACKAGE_PYTHON_MOPIDY_WEBSETTINGS
	bool "python-mopidy-websettings"
	select BR2_PACKAGE_PYTHON_SETUPTOOLS
	select BR2_PACKAGE_PYTHON_MOPIDY
	select BR2_PACKAGE_PYTHON_PYKKA
	select BR2_PACKAGE_PYTHON_CONFIGOBJ
	select BR2_PACKAGE_PYTHON_JINJA2
	help
	  Mopidy extension for editing settings in a webinterface

	  https://github.com/woutervanwijk/mopidy-websettings
```

## package/python-mopidy-youtube/Config.in
```kconfig
config BR2_PACKAGE_PYTHON_MOPIDY_YOUTUBE
	bool "python-mopidy-youtube"
	select BR2_PACKAGE_PYTHON_SETUPTOOLS
	select BR2_PACKAGE_PYTHON_REQUESTS
	select BR2_PACKAGE_PYTHON_PAFY
	select BR2_PACKAGE_PYTHON_MOPIDY
	select BR2_PACKAGE_PYTHON_PYKKA
	help
	  Mopidy extension that plays sound from YouTube

	  https://github.com/mopidy/mopidy-youtube
```

## package/python-mopidy/Config.in
```kconfig
config BR2_PACKAGE_PYTHON_MOPIDY
	bool "python-mopidy"
	select BR2_PACKAGE_PYTHON_PYKKA
	select BR2_PACKAGE_PYTHON_REQUESTS
	select BR2_PACKAGE_PYTHON_SETUPTOOLS
	select BR2_PACKAGE_PYTHON_TORNADO
	select BR2_PACKAGE_PYTHON_GOBJECT
	select BR2_PACKAGE_PYTHON_URLLIB3
	select BR2_PACKAGE_PYTHON_ZLIB
	select BR2_PACKAGE_PYTHON_BACKPORTSSSL_MATCH_HOSTNAME
	help
	  Music server with MPD and Spotify support

	  http://www.mopidy.com/
```

## package/python-pafy/Config.in
```kconfig
config BR2_PACKAGE_PYTHON_PAFY
	bool "python-pafy"
	help
	  Retrieve YouTube content and metadata

	  http://np1.github.io/pafy/
```

## package/python-pbkdf2/Config.in
```kconfig
config BR2_PACKAGE_PYTHON_PBKDF2
	bool "python-pbkdf2"
	help
	  PKCS#5 v2.0 PBKDF2 Module.

	  http://www.dlitz.net/software/python-pbkdf2/
```
