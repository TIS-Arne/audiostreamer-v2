## package/python-pylast/Config.in
```kconfig
config BR2_PACKAGE_PYTHON_PYLAST
	bool "python-pylast"
	select BR2_PACKAGE_PYTHON_SIX
	help
	  A Python interface to Last.fm and Libre.fm

	  https://github.com/pylast/pylast
```

## package/python-pyspotify/Config.in
```kconfig
config BR2_PACKAGE_PYTHON_PYSPOTIFY
	bool "python-pyspotify"
	select BR2_PACKAGE_PYTHON_CFFI
	select BR2_PACKAGE_LIBSPOTIFY_ARMHF
	help
	  Python wrapper for libspotify

	  http://pyspotify.mopidy.com/
```

## package/python-spotipy/Config.in
```kconfig
config BR2_PACKAGE_PYTHON_SPOTIPY
	bool "python-spotipy"
	select BR2_PACKAGE_PYTHON_REQUESTS
	help
	  simple client for the Spotify Web API

	  http://spotipy.readthedocs.org/
```

## package/python-uritools/Config.in
```kconfig
config BR2_PACKAGE_PYTHON_URITOOLS
	bool "python-uritools"
	select BR2_PACKAGE_PYTHON_IPADDRESS
	help
	  RFC 3986 compliant, Unicode-aware, scheme-agnostic replacement for
	  urlparse

	  https://github.com/tkem/uritools/
```

## package/python-wifi/Config.in
```kconfig
config BR2_PACKAGE_PYTHON_WIFI
	bool "python-wifi"
	select BR2_PACKAGE_PYTHON_SETUPTOOLS # runtime
	select BR2_PACKAGE_PYTHON_PBKDF2 # runtime
	help
	  Command line tool and library wrappers around iwlist and
	  /etc/network/interfaces.

	  UNKNOWN
```

## package/python-youtube_dl/Config.in
```kconfig
config BR2_PACKAGE_PYTHON_YOUTUBE_DL
	bool "python-youtube_dl"
	help
	  YouTube video downloader.

	  https://github.com/rg3/youtube-dl
```

## target/defconfig
```kconfig
BR2_arm=y
BR2_cortex_a7=y
BR2_ARM_FPU_NEON_VFPV4=y
BR2_JLEVEL=2
BR2_CCACHE=y
BR2_TOOLCHAIN_BUILDROOT_GLIBC=y
BR2_PACKAGE_HOST_LINUX_HEADERS_CUSTOM_4_4=y
BR2_TOOLCHAIN_BUILDROOT_CXX=y
BR2_PACKAGE_HOST_GDB=y
BR2_PACKAGE_HOST_GDB_PYTHON=y
BR2_INIT_SYSTEMD=y
BR2_TARGET_GENERIC_ROOT_PASSWD="root"
# BR2_TARGET_GENERIC_GETTY is not set
BR2_SYSTEM_DHCP="eth0"
BR2_ROOTFS_OVERLAY="target/overlay"
BR2_ROOTFS_POST_BUILD_SCRIPT="target/post-build.sh"
BR2_ROOTFS_POST_IMAGE_SCRIPT="target/post-image.sh"
BR2_ROOTFS_POST_SCRIPT_ARGS="--add-pi3-miniuart-bt-overlay"
BR2_LINUX_KERNEL=y
BR2_LINUX_KERNEL_CUSTOM_GIT=y
BR2_LINUX_KERNEL_CUSTOM_REPO_URL="https://github.com/raspberrypi/linux.git"
BR2_LINUX_KERNEL_CUSTOM_REPO_VERSION="c6d86f7aa554854b04614ebb4d394766081fb41f"
BR2_LINUX_KERNEL_DEFCONFIG="bcm2709"
BR2_LINUX_KERNEL_DTS_SUPPORT=y
BR2_LINUX_KERNEL_INTREE_DTS_NAME="bcm2709-rpi-2-b bcm2710-rpi-3-b overlays/iqaudio-dacplus-overlay"
BR2_PACKAGE_GSTREAMER1=y
BR2_PACKAGE_GST1_PLUGINS_BASE_PLUGIN_APP=y
BR2_PACKAGE_GST1_PLUGINS_BASE_PLUGIN_AUDIORATE=y
BR2_PACKAGE_GST1_PLUGINS_BASE_PLUGIN_AUDIOTESTSRC=y
# BR2_PACKAGE_GST1_PLUGINS_BASE_PLUGIN_VIDEOSCALE is not set
BR2_PACKAGE_GST1_PLUGINS_BASE_PLUGIN_ALSA=y
BR2_PACKAGE_GST1_PLUGINS_BASE_PLUGIN_OGG=y
BR2_PACKAGE_GST1_PLUGINS_BASE_PLUGIN_OPUS=y
BR2_PACKAGE_GST1_PLUGINS_BASE_PLUGIN_VORBIS=y
BR2_PACKAGE_GST1_PLUGINS_GOOD=y
BR2_PACKAGE_GST1_PLUGINS_GOOD_JPEG=y
BR2_PACKAGE_GST1_PLUGINS_GOOD_PNG=y
BR2_PACKAGE_GST1_PLUGINS_GOOD_ZLIB=y
BR2_PACKAGE_GST1_PLUGINS_GOOD_PLUGIN_AUDIOFX=y
BR2_PACKAGE_GST1_PLUGINS_GOOD_PLUGIN_AUDIOPARSERS=y
BR2_PACKAGE_GST1_PLUGINS_GOOD_PLUGIN_AUTODETECT=y
# BR2_PACKAGE_GST1_PLUGINS_GOOD_PLUGIN_AVI is not set
BR2_PACKAGE_GST1_PLUGINS_GOOD_PLUGIN_EQUALIZER=y
BR2_PACKAGE_GST1_PLUGINS_GOOD_PLUGIN_ID3DEMUX=y
# BR2_PACKAGE_GST1_PLUGINS_GOOD_PLUGIN_ISOMP4 is not set
BR2_PACKAGE_GST1_PLUGINS_GOOD_PLUGIN_REPLAYGAIN=y
BR2_PACKAGE_GST1_PLUGINS_GOOD_PLUGIN_WAVENC=y
BR2_PACKAGE_GST1_PLUGINS_GOOD_PLUGIN_FLAC=y
BR2_PACKAGE_GST1_PLUGINS_GOOD_PLUGIN_PULSE=y
BR2_PACKAGE_GST1_PLUGINS_GOOD_PLUGIN_SOUPHTTPSRC=y
BR2_PACKAGE_GST1_PLUGINS_GOOD_PLUGIN_SPEEX=y
BR2_PACKAGE_GST1_PLUGINS_GOOD_PLUGIN_WAVPACK=y
BR2_PACKAGE_GST1_PLUGINS_BAD=y
BR2_PACKAGE_GST1_PLUGINS_BAD_PLUGIN_ACCURIP=y
BR2_PACKAGE_GST1_PLUGINS_BAD_PLUGIN_AUDIOMIXER=y
BR2_PACKAGE_GST1_PLUGINS_BAD_PLUGIN_ID3TAG=y
BR2_PACKAGE_GST1_PLUGINS_BAD_PLUGIN_FAAD=y
BR2_PACKAGE_GST1_PLUGINS_UGLY=y
BR2_PACKAGE_GST1_PLUGINS_UGLY_PLUGIN_LAME=y
BR2_PACKAGE_GST1_PLUGINS_UGLY_PLUGIN_MAD=y
BR2_PACKAGE_GST1_PLUGINS_UGLY_PLUGIN_MPG123=y
BR2_PACKAGE_GST1_PYTHON=y
BR2_PACKAGE_GDB=y
BR2_PACKAGE_RPI_FIRMWARE=y
BR2_PACKAGE_PYTHON=y
BR2_PACKAGE_PYTHON_BZIP2=y
BR2_PACKAGE_PYTHON_READLINE=y
BR2_PACKAGE_PYTHON_SSL=y
BR2_PACKAGE_PYTHON_MOPIDY_CD=y
BR2_PACKAGE_PYTHON_MOPIDY_INTERNETARCHIVE=y
BR2_PACKAGE_PYTHON_MOPIDY_MATERIAL_WEBCLIENT=y
BR2_PACKAGE_PYTHON_MOPIDY_MOBILE=y
BR2_PACKAGE_PYTHON_MOPIDY_MOPED=y
BR2_PACKAGE_PYTHON_MOPIDY_MOPIFY=y
BR2_PACKAGE_PYTHON_MOPIDY_MUSICBOX_WEBCLIENT=y
BR2_PACKAGE_PYTHON_MOPIDY_PARTY=y
BR2_PACKAGE_PYTHON_MOPIDY_SPOTIFY=y
BR2_PACKAGE_PYTHON_MOPIDY_SPOTMOP=y
BR2_PACKAGE_PYTHON_MOPIDY_TUNEIN=y
BR2_PACKAGE_PYTHON_MOPIDY_WEBSETTINGS=y
BR2_PACKAGE_PYTHON_MOPIDY_YOUTUBE=y
BR2_PACKAGE_PYTHON_YOUTUBE_DL=y
BR2_PACKAGE_CA_CERTIFICATES=y
BR2_PACKAGE_CONNMAN=y
BR2_PACKAGE_CONNMAN_WIFI=y
BR2_PACKAGE_CONNMAN_BLUETOOTH=y
BR2_PACKAGE_CONNMAN_LOOPBACK=y
BR2_PACKAGE_CONNMAN_CLIENT=y
BR2_PACKAGE_DROPBEAR=y
BR2_PACKAGE_DROPBEAR_DISABLE_REVERSEDNS=y
BR2_PACKAGE_SYSTEMD_LOGIND=y
# BR2_PACKAGE_SYSTEMD_NETWORKD is not set
BR2_PACKAGE_LESS=y
BR2_PACKAGE_NANO=y
BR2_TARGET_ROOTFS_EXT2=y
BR2_TARGET_ROOTFS_EXT2_4=y
# BR2_TARGET_ROOTFS_TAR is not set
BR2_PACKAGE_HOST_DOSFSTOOLS=y
BR2_PACKAGE_HOST_GENIMAGE=y
BR2_PACKAGE_HOST_MTOOLS=y
```
